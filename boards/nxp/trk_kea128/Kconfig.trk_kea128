## boards/nxp/trk_kea128/Kconfig.trk_kea128
```kconfig
# NXP TRK-KEA128 board configuration

config BOARD_TRK_KEA128
	select SOC_SKEAZ1284
```

## boards/nxp/trk_kea128/board.yml
```yaml
board:
  name: trk_kea128
  full_name: TRK-KEA128
  vendor: nxp
  socs:
    - name: skeaz1284
```

## boards/nxp/trk_kea128/trk_kea128_defconfig
```kconfig
CONFIG_CONSOLE=y
CONFIG_SERIAL=y
CONFIG_UART_CONSOLE=y
CONFIG_GPIO=y
CONFIG_I2C=y
CONFIG_SPI=y
CONFIG_LOG=n
CONFIG_ADC=y
CONFIG_PWM=y
CONFIG_COUNTER=y
CONFIG_CAN=y
CONFIG_WATCHDOG=y
CONFIG_CLOCK_CONTROL=y
CONFIG_PINCTRL=y
```

## dts/bindings/adc/nxp,kea-adc.yaml
```yaml
description: NXP Kinetis KEA ADC

compatible: "nxp,kea-adc"

include: adc-controller.yaml

properties:
  reg:
    type: array
    required: true

  interrupts:
    type: array
    required: true

  "#io-channel-cells":
    const: 1

  clock-frequency:
    type: int
    required: true
    description: ADC input clock frequency in Hz

  clocks:
    type: phandle-array
    required: true
    description: Clock controller phandle and gate mask

  nxp,clock-gate-mask:
    type: int
    description: Deprecated legacy SIM_SCGC bitmask

io-channel-cells:
  - input
```

## dts/bindings/can/nxp,kea-mscan.yaml
```yaml
description: NXP Kinetis KEA MSCAN controller

compatible: "nxp,kea-mscan"

include:
  - can-controller.yaml
  - pinctrl-device.yaml

properties:
  reg:
    type: array
    required: true

  interrupts:
    type: array
    required: true

  interrupt-names:
    type: string-array
    required: true
    description: Must contain rx and tx

  clock-frequency:
    type: int
    required: true
    description: MSCAN input clock frequency in Hz

  clocks:
    type: phandle-array
    required: true
    description: Clock controller phandle and gate mask

  nxp,clock-gate-mask:
    type: int
    description: Deprecated legacy SIM_SCGC bitmask

  nxp,pinsel1-mask:
    type: int
    description: Deprecated legacy SIM_PINSEL1 bits
```

## dts/bindings/clock/nxp,kea-sim-clock.yaml
```yaml
description: NXP Kinetis KEA SIM clock controller

compatible: "nxp,kea-sim-clock"

include: [base.yaml, clock-controller.yaml]

properties:
  reg:
    type: array
    required: true

  "#clock-cells":
    type: int
    const: 1

  clock-frequency:
    type: int
    required: true
    description: Peripheral bus clock frequency in Hz

  nxp,fll-clock-frequency:
    type: int
    description: >
      Internal FLL output clock in Hz used as the root clock for runtime
      bus-rate derivation.

  nxp,derive-rate-from-dividers:
    type: boolean
    description: >
      If present, derive bus rate from ICS and SIM divider registers at
      runtime instead of returning a fixed clock-frequency value.

clock-cells:
  - bits
```

## dts/bindings/counter/nxp,kea-pit-counter.yaml
```yaml
description: NXP Kinetis KEA PIT counter

compatible: "nxp,kea-pit-counter"

include: base.yaml

properties:
  reg:
    type: array
    required: true

  interrupts:
    type: array
    required: true

  interrupt-names:
    type: string-array
    required: true
    description: Must contain ch0 and ch1

  clock-frequency:
    type: int
    required: true
    description: PIT input clock frequency in Hz

  clocks:
    type: phandle-array
    required: true
    description: Clock controller phandle and gate mask

  nxp,clock-gate-mask:
    type: int
    description: Deprecated legacy SIM_SCGC bitmask
```

## dts/bindings/flash_controller/nxp,kea-ftmre-flash-controller.yaml
```yaml
description: NXP Kinetis KEA FTMRE internal flash controller

compatible: "nxp,kea-ftmre-flash-controller"

include: [base.yaml, flash-controller.yaml]

properties:
  reg:
    type: array
    required: true
```

## dts/bindings/gpio/nxp,kea-gpio.yaml
```yaml
description: NXP Kinetis KEA GPIO

compatible: "nxp,kea-gpio"

include: gpio-controller.yaml

properties:
  reg:
    type: array
    required: true

  clocks:
    type: phandle-array
    required: false
    description: Optional KBI clock controller phandle and gate mask

  interrupts:
    type: array
    required: false
    description: Optional KBI interrupt line for this GPIO bank

  ngpios:
    type: int
    required: true

  gpio-controller:
    type: boolean
    required: true

  "#gpio-cells":
    const: 2

gpio-cells:
  - pin
  - flags
```

## dts/bindings/i2c/nxp,kea-i2c.yaml
```yaml
description: NXP Kinetis KEA I2C

compatible: "nxp,kea-i2c"

include:
  - i2c-controller.yaml
  - pinctrl-device.yaml

properties:
  reg:
    type: array
    required: true

  interrupts:
    type: array
    required: true

  clock-frequency:
    type: int
    required: true
    description: Desired I2C bus bitrate in Hz

  nxp,module-clock-frequency:
    type: int
    required: true
    description: I2C peripheral module clock in Hz

  clocks:
    type: phandle-array
    required: true
    description: Clock controller phandle and gate mask

  nxp,clock-gate-mask:
    type: int
    description: Deprecated legacy SIM_SCGC bitmask

  nxp,pinsel0-mask:
    type: int
    description: Deprecated legacy SIM_PINSEL bits

  nxp,pinsel1-mask:
    type: int
    description: Deprecated legacy SIM_PINSEL1 bits
```

## dts/bindings/pinctrl/nxp,kea-pinctrl.yaml
```yaml
description: NXP Kinetis KEA pin controller

compatible: "nxp,kea-pinctrl"

include: base.yaml

child-binding:
  description: KEA pinctrl state node
  child-binding:
    description: KEA pinctrl group
    properties:
      pinmux:
        type: array
        required: true
        description: |
          Encoded SIM routing values.
          bit31 selects SIM_PINSEL1 when set, otherwise SIM_PINSEL.
          bits30..0 are ORed into the selected register.
```

## dts/bindings/pwm/nxp,kea-ftm-pwm.yaml
```yaml
description: NXP Kinetis KEA FTM PWM

compatible: "nxp,kea-ftm-pwm"

include:
  - pwm-controller.yaml
  - pinctrl-device.yaml

properties:
  reg:
    type: array
    required: true

  interrupts:
    type: array
    required: true

  "#pwm-cells":
    const: 3

  clock-frequency:
    type: int
    required: true
    description: FTM input clock frequency in Hz

  clocks:
    type: phandle-array
    required: true
    description: Clock controller phandle and gate mask

  nxp,clock-gate-mask:
    type: int
    description: Deprecated legacy SIM_SCGC bitmask

  nxp,prescaler:
    type: int
    default: 7
    enum:
      - 0
      - 1
      - 2
      - 3
      - 4
      - 5
      - 6
      - 7
    description: Prescaler field value programmed in FTM_SC[PS]

pwm-cells:
  - channel
  - period
  - flags
```

## dts/bindings/serial/nxp,kea-uart.yaml
```yaml
description: NXP Kinetis KEA UART

compatible: "nxp,kea-uart"

include:
  - uart-controller.yaml
  - pinctrl-device.yaml

properties:
  reg:
    type: array
    required: true

  interrupts:
    type: array
    required: true

  current-speed:
    required: true

  clock-frequency:
    type: int
    required: true
    description: UART input clock frequency in Hz

  clocks:
    type: phandle-array
    required: true
    description: Clock controller phandle and gate mask

  nxp,clock-gate-mask:
    type: int
    description: Deprecated legacy SIM_SCGC bitmask

  nxp,pinsel0-mask:
    type: int
    description: Deprecated legacy SIM_PINSEL bits

  nxp,pinsel1-mask:
    type: int
    description: Deprecated legacy SIM_PINSEL1 bits
```

## dts/bindings/spi/nxp,kea-spi.yaml
```yaml
description: NXP Kinetis KEA SPI

compatible: "nxp,kea-spi"

include:
  - spi-controller.yaml
  - pinctrl-device.yaml

properties:
  reg:
    type: array
    required: true

  interrupts:
    type: array
    required: true

  nxp,clock-frequency:
    type: int
    required: true
    description: SPI peripheral module clock in Hz

  clocks:
    type: phandle-array
    required: true
    description: Clock controller phandle and gate mask

  nxp,clock-gate-mask:
    type: int
    description: Deprecated legacy SIM_SCGC bitmask

  nxp,pinsel0-mask:
    type: int
    description: Deprecated legacy SIM_PINSEL bits

  nxp,pinsel1-mask:
    type: int
    description: Deprecated legacy SIM_PINSEL1 bits
```

## dts/bindings/watchdog/nxp,kea-wdog.yaml
```yaml
description: NXP Kinetis KEA watchdog

compatible: "nxp,kea-wdog"

include: base.yaml

properties:
  reg:
    type: array
    required: true

  interrupts:
    type: array
    required: true
```

## soc/nxp/kea/Kconfig
```kconfig
config SOC_SERIES_KEA
	select ARM
	select CLOCK_CONTROL
	select CPU_CORTEX_M0PLUS
	select CPU_CORTEX_M_HAS_SYSTICK
	select CPU_CORTEX_M_HAS_VTOR
	select PINCTRL
	select SOC_EARLY_INIT_HOOK

if SOC_SERIES_KEA

config UART_KEA
	bool "NXP KEA UART driver"
	default y
	depends on SERIAL && DT_HAS_NXP_KEA_UART_ENABLED
	select SERIAL_HAS_DRIVER
	help
	  Enable the UART driver for KEA UART peripherals.

config ADC_KEA
	bool "NXP KEA ADC driver"
	default y
	depends on ADC && DT_HAS_NXP_KEA_ADC_ENABLED
	help
	  Enable the ADC driver for KEA ADC peripherals.

config GPIO_KEA
	bool "NXP KEA GPIO driver"
	default y
	depends on GPIO && DT_HAS_NXP_KEA_GPIO_ENABLED
	help
	  Enable the GPIO driver for KEA GPIO peripherals.

config I2C_KEA
	bool "NXP KEA I2C driver"
	default y
	depends on I2C && DT_HAS_NXP_KEA_I2C_ENABLED
	help
	  Enable the I2C controller driver for KEA I2C peripherals.

config SPI_KEA
	bool "NXP KEA SPI driver"
	default y
	depends on SPI && DT_HAS_NXP_KEA_SPI_ENABLED
	help
	  Enable the SPI controller driver for KEA SPI peripherals.

config PWM_KEA_FTM
	bool "NXP KEA FTM PWM driver"
	default y
	depends on PWM && DT_HAS_NXP_KEA_FTM_PWM_ENABLED
	help
	  Enable the PWM driver for KEA FTM peripherals.

config COUNTER_KEA_PIT
	bool "NXP KEA PIT counter driver"
	default y
	depends on COUNTER && DT_HAS_NXP_KEA_PIT_COUNTER_ENABLED
	help
	  Enable the counter driver for KEA PIT peripherals.

config CAN_KEA_MSCAN
	bool "NXP KEA MSCAN driver"
	default y
	depends on CAN && DT_HAS_NXP_KEA_MSCAN_ENABLED && !CAN_FD_MODE
	help
	  Enable the CAN 2.0 driver for KEA MSCAN peripherals.

config CAN_KEA_MSCAN_MAX_FILTER
	int "NXP KEA MSCAN maximum RX filters"
	default 8
	range 1 16
	depends on CAN_KEA_MSCAN
	help
	  Number of software RX filters available in the KEA MSCAN driver.

config WDT_KEA
	bool "NXP KEA watchdog driver"
	default y
	depends on WATCHDOG && DT_HAS_NXP_KEA_WDOG_ENABLED
	select HAS_WDT_NO_CALLBACKS
	help
	  Enable the watchdog driver for KEA WDOG peripherals.

config CLOCK_CONTROL_KEA_SIM
	bool "NXP KEA SIM clock control driver"
	default y
	depends on CLOCK_CONTROL && DT_HAS_NXP_KEA_SIM_CLOCK_ENABLED
	help
	  Enable the SIM-backed clock control driver for KEA peripherals.

config FLASH_KEA_FTMRE
	bool "NXP KEA FTMRE flash driver"
	default y
	depends on FLASH && DT_HAS_NXP_KEA_FTMRE_FLASH_CONTROLLER_ENABLED
	select FLASH_HAS_DRIVER_ENABLED
	select FLASH_HAS_EXPLICIT_ERASE
	select FLASH_HAS_PAGE_LAYOUT
	help
	  Enable the internal flash driver for the KEA FTMRE controller.

config PINCTRL_KEA
	bool "NXP KEA pin control support"
	default y
	depends on PINCTRL && DT_HAS_NXP_KEA_PINCTRL_ENABLED
	help
	  Enable pin control support for KEA SIM PINSEL/PINSEL1 routing.

endif # SOC_SERIES_KEA
```

## soc/nxp/kea/Kconfig.defconfig
```kconfig
if SOC_SERIES_KEA

config NUM_IRQS
	default 32

config SYS_CLOCK_HW_CYCLES_PER_SEC
	default 20000000

endif
```

## soc/nxp/kea/Kconfig.soc
```kconfig
config SOC_FAMILY_NXP_KEA
	bool

config SOC_FAMILY
	default "nxp_kea" if SOC_FAMILY_NXP_KEA

config SOC_SERIES_KEA
	bool
	select SOC_FAMILY_NXP_KEA

config SOC_SERIES
	default "kea" if SOC_SERIES_KEA

config SOC_SKEAZ1284
	bool
	select SOC_SERIES_KEA

config SOC
	default "skeaz1284" if SOC_SKEAZ1284

config SOC_PART_NUMBER_SKEAZ128XXX4
	bool

config SOC_PART_NUMBER
	default "SKEAZ128xxx4" if SOC_PART_NUMBER_SKEAZ128XXX4
```

## tests/kea/per_driver_build/testcase.yaml
```yaml
common:
  tags:
    - kea
    - drivers
    - build
  build_only: true
  platform_allow:
    - trk_kea128/skeaz1284

tests:
  kea.per_driver_build.gpio:
    extra_configs:
      - CONFIG_KEA_TEST_GPIO=y

  kea.per_driver_build.uart:
    extra_configs:
      - CONFIG_KEA_TEST_UART=y

  kea.per_driver_build.i2c:
    extra_configs:
      - CONFIG_KEA_TEST_I2C=y

  kea.per_driver_build.i2c_target:
    extra_configs:
      - CONFIG_KEA_TEST_I2C=y
      - CONFIG_I2C_TARGET=y

  kea.per_driver_build.spi:
    extra_configs:
      - CONFIG_KEA_TEST_SPI=y

  kea.per_driver_build.spi_async:
    extra_configs:
      - CONFIG_KEA_TEST_SPI=y
      - CONFIG_SPI_ASYNC=y

  kea.per_driver_build.adc:
    extra_configs:
      - CONFIG_KEA_TEST_ADC=y

  kea.per_driver_build.pwm:
    extra_configs:
      - CONFIG_KEA_TEST_PWM=y

  kea.per_driver_build.counter:
    extra_configs:
      - CONFIG_KEA_TEST_COUNTER=y

  kea.per_driver_build.can:
    extra_configs:
      - CONFIG_KEA_TEST_CAN=y

  kea.per_driver_build.wdt:
    extra_configs:
      - CONFIG_KEA_TEST_WDT=y

  kea.per_driver_build.flash:
    extra_configs:
      - CONFIG_KEA_TEST_FLASH=y
      - CONFIG_FLASH=y
      - CONFIG_FLASH_MAP=y
```

## west.yml
```yaml
manifest:
  version: 0.13

  remotes:
    - name: zephyrproject
      url-base: https://github.com/zephyrproject-rtos

  projects:
    - name: zephyr
      remote: zephyrproject
      revision: main
      west-commands: scripts/west-commands.yml
    - name: cmsis_6
      remote: zephyrproject
      repo-path: CMSIS_6
      path: modules/hal/cmsis_6
      revision: main
```
